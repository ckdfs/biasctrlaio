## boards/xidian/biasctrl_h503/Kconfig.biasctrl_h503
```kconfig
# SPDX-License-Identifier: Apache-2.0

config BOARD_BIASCTRL_H503
	select SOC_STM32H503XX
```

## boards/xidian/biasctrl_h503/board.yml
```yaml
board:
  name: biasctrl_h503
  full_name: Xidian Bias Controller Digital Baseboard
  vendor: xidian
  socs:
    - name: stm32h503xx
```

## drivers/ads131m02/Kconfig
```kconfig
# SPDX-License-Identifier: Apache-2.0
config BIAS_ADS131M02
	bool "Bias controller ADS131M02 acquisition"
	default n
	depends on DT_HAS_TI_ADS131M02_ENABLED
	select GPIO
	select SPI
	select DMA if SOC_SERIES_STM32H5X
```

## drivers/analog_board/Kconfig
```kconfig
# SPDX-License-Identifier: Apache-2.0
config BIAS_ANALOG_BOARD_20261110_MZM
	bool "20261110-MZM analog daughterboard backend"
	default n
	select BIAS_PILOT_MUX
	select BIAS_DAC8568
	select BIAS_EEPROM_BOARD
	help
	  Provides the analog_board_ops_t implementation for the 20261110-MZM
	  split-board daughterboard (6 DC + 2 Pilot + 8-ch TS5A23159 + P24C02A).
```

## drivers/dac8568/Kconfig
```kconfig
# SPDX-License-Identifier: Apache-2.0
config BIAS_DAC8568
	bool "Bias controller DAC8568"
	default n
	depends on SOC_SERIES_STM32H5X && DT_HAS_TI_DAC8568_ENABLED
	select GPIO
	select DMA
	select SPI
```

## drivers/eeprom_board/Kconfig
```kconfig
config BIAS_EEPROM_BOARD
	bool "P24C02A daughterboard descriptor store"
	default n
	depends on I2C
	select CRC
```

## drivers/oled_lite/Kconfig
```kconfig
config BIAS_OLED_LITE
	bool "OLED1 display and debounced dial keys"
	default n
	depends on I2C && GPIO
```

## drivers/pilot_mux/Kconfig
```kconfig
# SPDX-License-Identifier: Apache-2.0
config BIAS_PILOT_MUX
	bool "TS5A23159 pilot switch matrix"
	depends on GPIO
	help
	  Initialize all eight pilot-sw-gpios LOW and enable routing using the
	  analog daughterboard's pilot route table.
```

## dts/bindings/dac/ti,dac8568.yaml
```yaml
# SPDX-License-Identifier: Apache-2.0
description: Texas Instruments DAC8568 eight-channel 16-bit DAC
compatible: "ti,dac8568"
include: spi-device.yaml
properties:
  ldac-gpios:
    type: phandle-array
    required: true
    description: Active-low output update strobe.
  clr-gpios:
    type: phandle-array
    required: true
    description: Active-low hardware clear.
```

## manifest/west.yml
```yaml
manifest:
  remotes:
    - name: zephyrproject-rtos
      url-base: https://github.com/zephyrproject-rtos
  projects:
    - name: zephyr
      remote: zephyrproject-rtos
      revision: v4.5.0
      path: zephyr
      import:
        path-prefix: deps
        name-allowlist:
          - cmsis
          - cmsis_6
          - hal_stm32
          - picolibc
```
