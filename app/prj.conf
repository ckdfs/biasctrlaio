## CMakeLists.txt
```
# SPDX-License-Identifier: Apache-2.0
cmake_minimum_required(VERSION 3.20.0)

list(APPEND BOARD_ROOT ${CMAKE_CURRENT_LIST_DIR}/..)
list(APPEND ZEPHYR_EXTRA_MODULES ${CMAKE_CURRENT_LIST_DIR}/..)
find_package(Zephyr REQUIRED HINTS $ENV{ZEPHYR_BASE})
project(biasctrl_h503)

target_sources(app PRIVATE
  src/main.c
  src/rt_pipeline.c
  src/cal_service.c
  src/ctrl_thread.c
  src/cli_service.c
)

execute_process(COMMAND git describe --always --dirty --exclude "*"
  WORKING_DIRECTORY ${CMAKE_CURRENT_LIST_DIR}
  OUTPUT_VARIABLE firmware_revision OUTPUT_STRIP_TRAILING_WHITESPACE
  COMMAND_ERROR_IS_FATAL ANY)
target_compile_definitions(app PRIVATE BIAS_FW_REV="${firmware_revision}")
```

## prj.conf
```kconfig
CONFIG_SERIAL=y
CONFIG_CONSOLE=y
CONFIG_UART_CONSOLE=y
CONFIG_UART_INTERRUPT_DRIVEN=y
CONFIG_PRINTK=y
CONFIG_GPIO=y
CONFIG_I2C=y
CONFIG_SPI=y
CONFIG_DMA=y
CONFIG_PICOLIBC=y
CONFIG_MAIN_STACK_SIZE=2048
CONFIG_SYSTEM_WORKQUEUE_STACK_SIZE=1024
CONFIG_BIAS_ANALOG_BOARD_20261110_MZM=y
CONFIG_BIAS_ADS131M02=y
CONFIG_BIAS_OLED_LITE=y
CONFIG_FPU=y
CONFIG_FPU_SHARING=y
```

## src/main.c
```c
/* SPDX-License-Identifier: Apache-2.0 */
#include "cli_service.h"
#include "ctrl_thread.h"

#include <bias/analog_board.h>
#include <keys.h>
#include <oled_lite.h>

#include <errno.h>
#include <math.h>
#include <stdbool.h>
#include <stdint.h>
#include <stdio.h>
#include <string.h>
#include <zephyr/device.h>
#include <zephyr/drivers/gpio.h>
#include <zephyr/kernel.h>
#include <zephyr/sys/printk.h>

#define OLED_REFRESH_MS 500U
#define LED_PERIOD_NORMAL_MS 500U
#define LED_PERIOD_FAULT_MS 150U

static const struct gpio_dt_spec led = GPIO_DT_SPEC_GET(DT_ALIAS(led0), gpios);
static const struct gpio_dt_spec spare_pa8 =
	GPIO_DT_SPEC_GET(DT_PATH(zephyr_user), spare_pa8_gpios);

static const char *oled_state_str(ctrl_state_t state)
{
	switch (state) {
	case CTRL_STATE_IDLE:
		return "IDLE";
	case CTRL_STATE_SCAN:
		return "SCAN";
	case CTRL_STATE_CAL:
		return "CAL";
	case CTRL_STATE_EXP_HOLD:
		return "HOLD";
	case CTRL_STATE_RUNNING:
		return "RUN";
	case CTRL_STATE_FAULT:
		return "FLT";
	default:
		return "UNK";
	}
}

static const char *oled_target_str(bias_point_t target)
{
	switch (target) {
	case BIAS_POINT_QUAD:
		return "QUAD";
	case BIAS_POINT_MAX:
		return "MAX";
	case BIAS_POINT_MIN:
		return "MIN";
	case BIAS_POINT_CUSTOM:
		return "CUST";
	default:
		return "UNK";
	}
}

static int oled_mv_clamped(float v)
{
	if (!isfinite(v)) {
		return 0;
	}
	double mv = (double)v * 1000.0;

	if (mv > 99999.0) {
		return 99999;
	}
	if (mv < -99999.0) {
		return -99999;
	}
	return (int)(mv >= 0.0 ? (mv + 0.5) : (mv - 0.5));
}

static void format_oled_lines(int board_rc, int keys_rc, int cli_rc,
			      int st_rc, const ctrl_thread_status_t *st,
			      char lines[3][22])
{
	if (st_rc < 0) {
		(void)snprintf(lines[0], 22, "BRD:%d CTRL:%d", board_rc, st->load_error);
		(void)snprintf(lines[1], 22, "KEYS:%d CLI:%d", keys_rc, cli_rc);
		(void)snprintf(lines[2], 22, "RUN EEPROM INIT");
		return;
	}

	(void)snprintf(lines[0], 22, "ST:%s CAL:%d LCK:%d",
		       oled_state_str(st->state), st->calibrated ? 1 : 0,
		       st->locked ? 1 : 0);
	(void)snprintf(lines[1], 22, "TGT:%s VA:%dMV",
		       oled_target_str(st->target), oled_mv_clamped(st->bias_v));
	if (st->state == CTRL_STATE_FAULT) {
		(void)snprintf(lines[2], 22, "FLT:%d CLN:%d", st->fault, st->cleanup_error);
	} else if (!st->calibrated) {
		(void)snprintf(lines[2], 22, "UNCAL LOAD:%d", st->load_error);
	} else {
		(void)snprintf(lines[2], 22, "VPI:%dMV HA:%d",
			       oled_mv_clamped(st->vpi_v),
			       st->hold_assist_active ? 1 : 0);
	}
}

static void render_oled_if_changed(int board_rc, int keys_rc, int cli_rc,
				   int st_rc, const ctrl_thread_status_t *st,
				   bool *initialized_view, char prev[3][22])
{
	char next[3][22];

	format_oled_lines(board_rc, keys_rc, cli_rc, st_rc, st, next);
	if (*initialized_view &&
	    memcmp(prev, next, sizeof(next)) == 0) {
		return;
	}

	oled_lite_clear();
	(void)oled_lite_text(0, 0, "BIASCTRL H503 P7");
	(void)oled_lite_text(0, 16, next[0]);
	(void)oled_lite_text(0, 32, next[1]);
	(void)oled_lite_text(0, 48, next[2]);
	(void)oled_lite_flush();

	memcpy(prev, next, sizeof(next));
	*initialized_view = true;
}

int main(void)
{
	const analog_board_ops_t *ops = analog_board_get_ops();
	bool led_ready = false;

	if (gpio_is_ready_dt(&spare_pa8)) {
		(void)gpio_pin_configure_dt(&spare_pa8, GPIO_OUTPUT_INACTIVE);
	}
	if (gpio_is_ready_dt(&led) &&
	    gpio_pin_configure_dt(&led, GPIO_OUTPUT_INACTIVE) == 0) {
		led_ready = true;
	}

	printk("\nbiasctrl_h503 Phase 7, SYSCLK %u Hz\n",
	       (unsigned int)DT_PROP(DT_NODELABEL(rcc), clock_frequency));

	int board_rc = (ops != NULL && ops->init != NULL) ? ops->init() : -ENODEV;

	printk("analog_board init (%s): %d\n",
	       (ops != NULL && ops->caps != NULL) ? ops->caps->board_id : "none",
	       board_rc);

	int oled_rc = oled_lite_init();

	printk("oled_lite init: %d\n", oled_rc);

	int keys_rc = bias_keys_init(NULL, NULL);

	printk("keys init: %d\n", keys_rc);

	int ctrl_rc = ctrl_thread_init(ops, NULL, false);

	printk("ctrl_thread init: %d\n", ctrl_rc);

	int cli_rc = cli_service_start();

	printk("cli_service start: %d\n", cli_rc);

	bool hw_boot_fault = (board_rc < 0 || oled_rc < 0 || keys_rc < 0 ||
			      cli_rc < 0 || (ctrl_rc < 0 && ctrl_rc != -EBADMSG));
	bool oled_has_frame = false;
	char prev_lines[3][22] = { { 0 } };
	ctrl_thread_status_t st = { 0 };
	int st_rc = ctrl_thread_get_status(&st);

	if (oled_rc == 0) {
		render_oled_if_changed(board_rc, keys_rc, cli_rc, st_rc, &st,
				       &oled_has_frame, prev_lines);
	}

	bool in_fault = hw_boot_fault || (st_rc < 0) || (st.state == CTRL_STATE_FAULT);
	uint32_t blink_ms = in_fault ? LED_PERIOD_FAULT_MS : LED_PERIOD_NORMAL_MS;
	int64_t next_blink = k_uptime_get() + blink_ms;
	int64_t next_oled = k_uptime_get() + OLED_REFRESH_MS;

	while (true) {
		int64_t now = k_uptime_get();

		if (now >= next_oled) {
			st_rc = ctrl_thread_get_status(&st);
			in_fault = hw_boot_fault || (st_rc < 0) || (st.state == CTRL_STATE_FAULT);
			blink_ms = in_fault ? LED_PERIOD_FAULT_MS : LED_PERIOD_NORMAL_MS;
			if (oled_rc == 0) {
				render_oled_if_changed(board_rc, keys_rc, cli_rc, st_rc, &st,
						       &oled_has_frame, prev_lines);
			}
			next_oled = now + OLED_REFRESH_MS;
		}
		if (led_ready && now >= next_blink) {
			(void)gpio_pin_toggle_dt(&led);
			next_blink = now + blink_ms;
		}
		k_msleep(50);
	}
}
```

## src/cal_service.c
```c
/* SPDX-License-Identifier: Apache-2.0 */
#include "cal_service.h"

#include <errno.h>
#include <math.h>
#include <string.h>
#include <zephyr/drivers/i2c.h>
#include <zephyr/sys/crc.h>
#if DT_NODE_HAS_STATUS_OKAY(DT_NODELABEL(bias_eeprom))
#include <shared_i2c.h>
static const struct i2c_dt_spec u21 = I2C_DT_SPEC_GET(DT_NODELABEL(bias_eeprom));
#endif

#define RECORD_OFFSET 160u
#define RECORD_MAGIC 0x324d5a4du /* "MZM2" */
#define WIRE_CRC(obj) crc32_ieee((const uint8_t *)&(obj), offsetof(__typeof__(obj), crc32))

/* Little-endian, binary32. Use a fixed-width flag instead of persisting
 * implementation-defined bool layout. Bind the record to its descriptor. */
struct cal_mzm_record_v2 {
	uint32_t magic, descriptor_crc;
	dsp_affine_fit_t fit;
	float null_v, vpi_v, cal_pilot_v;
	float h1_ref_phase, h2_ref_phase;
	uint32_t has_ref_phases, reserved, crc32;
};
BUILD_ASSERT(sizeof(struct cal_mzm_record_v2) == 64);
BUILD_ASSERT(RECORD_OFFSET >= BIAS_EEPROM_V1_SIZE && RECORD_OFFSET % BIAS_EEPROM_PAGE_BYTES == 0);
BUILD_ASSERT(RECORD_OFFSET + sizeof(struct cal_mzm_record_v2) <= BIAS_EEPROM_CAPACITY_BYTES);

int cal_service_voltage_bounds(const struct bias_eeprom_descriptor_v1 *d, float *lo, float *hi)
{
	if (!d || !lo || !hi || !d->channels[0].subtractor_gain_ppm) {
		return -EINVAL;
	}
	double offset = d->channels[0].subtractor_offset_uv * 1e-6;
	double end = offset + 2.5e-6 * d->channels[0].subtractor_gain_ppm;
	*lo = MIN(offset, end);
	*hi = MAX(offset, end);
	return 0;
}

int cal_service_voltage_to_dac_code(const struct bias_eeprom_descriptor_v1 *d,
				    float voltage, uint16_t *code)
{
	float lo, hi;
	if (!code || !isfinite(voltage) || cal_service_voltage_bounds(d, &lo, &hi)) {
		return -EINVAL;
	}
	if (voltage < lo || voltage > hi) {
		return -ERANGE;
	}
	double fraction = ((double)voltage * 1e6 - d->channels[0].subtractor_offset_uv) /
			  (2.5 * d->channels[0].subtractor_gain_ppm);
	*code = (uint16_t)(CLAMP(fraction, 0., 1.) * 65535. + 0.5);
	return 0;
}

static int transfer(const cal_storage_ops_t *storage, struct cal_mzm_record_v2 *r, bool write)
{
	int rc = 0;
	if (storage && !(write ? storage->write_page != NULL : storage->read != NULL)) {
		return -EINVAL;
	}
#if DT_NODE_HAS_STATUS_OKAY(DT_NODELABEL(bias_eeprom))
	if (!storage) {
		if (!i2c_is_ready_dt(&u21)) {
			return -ENODEV;
		}
		k_mutex_lock(&bias_i2c1_mutex, K_FOREVER);
	}
#else
	if (!storage) {
		return -ENODEV;
	}
#endif
	for (size_t pos = 0; pos < sizeof(*r) && !rc;) {
		uint8_t addr = RECORD_OFFSET + pos;
		uint8_t *p = (uint8_t *)r + pos;
		size_t n = write ? MIN(BIAS_EEPROM_PAGE_BYTES, sizeof(*r) - pos) : sizeof(*r);
		if (storage) {
			rc = write ? storage->write_page(addr, p, n) : storage->read(addr, p, n);
		}
#if DT_NODE_HAS_STATUS_OKAY(DT_NODELABEL(bias_eeprom))
		else if (write) {
			uint8_t page[1 + BIAS_EEPROM_PAGE_BYTES] = {addr};
			memcpy(page + 1, p, n);
			rc = i2c_write_dt(&u21, page, n + 1);
			if (!rc) {
				k_msleep(BIAS_EEPROM_WRITE_CYCLE_MS);
			}
		} else {
			rc = i2c_write_read_dt(&u21, &addr, 1, p, n);
		}
#endif
		pos += n;
	}
#if DT_NODE_HAS_STATUS_OKAY(DT_NODELABEL(bias_eeprom))
	if (!storage) {
		k_mutex_unlock(&bias_i2c1_mutex);
	}
#endif
	return rc;
}

static bool valid_record(const struct cal_mzm_record_v2 *r)
{
	for (size_t i = 0; i < 2; i++) {
		if (!isfinite(r->fit.o[i]) || !isfinite(r->fit.m[i][0]) ||
		    !isfinite(r->fit.m[i][1])) {
			return false;
		}
	}
	double uv = (double)r->vpi_v * 1e6;
	return isfinite(r->null_v) && uv >= 0.5 && uv < UINT32_MAX + 0.5 &&
	       isfinite(r->cal_pilot_v) && r->cal_pilot_v > 0 &&
	       isfinite(r->h1_ref_phase) && isfinite(r->h2_ref_phase) &&
	       r->has_ref_phases <= 1 && r->reserved == 0;
}

int cal_service_save(const analog_board_ops_t *board, const cal_storage_ops_t *storage,
		     struct bias_eeprom_descriptor_v1 *desc, const ctrl_calibration_t *cal)
{
	if (!board || !board->store_calibration || !desc || !cal ||
	    !desc->channels[0].subtractor_gain_ppm || (storage && !storage->write_page)) {
		return -EINVAL;
	}
	struct cal_mzm_record_v2 r = {
		.magic = RECORD_MAGIC, .fit = cal->fit, .null_v = cal->null_v,
		.vpi_v = cal->vpi_v, .cal_pilot_v = cal->cal_pilot_v,
		.h1_ref_phase = cal->h1_ref_phase, .h2_ref_phase = cal->h2_ref_phase,
		.has_ref_phases = cal->has_ref_phases ? 1u : 0u,
		.reserved = 0u,
	};
	if (!valid_record(&r)) {
		return -EINVAL;
	}
	struct bias_eeprom_descriptor_v1 d = *desc;
	d.channels[0].vpi_uv = (uint32_t)((double)cal->vpi_v * 1e6 + 0.5);
	d.crc32 = WIRE_CRC(d);
	r.descriptor_crc = d.crc32;
	r.crc32 = WIRE_CRC(r);
	int rc = board->store_calibration(&d);
	if (!rc) {
		rc = transfer(storage, &r, true);
	}
	if (!rc) {
		*desc = d;
	}
	return rc;
}

int cal_service_load_descriptor(const analog_board_ops_t *board, struct bias_eeprom_descriptor_v1 *desc)
{
	if (!board || !board->load_calibration || !desc) {
		return -EINVAL;
	}
	struct bias_eeprom_descriptor_v1 d;
	int rc = board->load_calibration(&d);
	if (rc) {
		return rc;
	}
	if (d.magic != BIAS_EEPROM_MAGIC || d.schema_version != BIAS_EEPROM_SCHEMA_V1 ||
	    d.length_bytes != sizeof(d) || memcmp(d.board_id, "20261110-MZM", sizeof(d.board_id)) ||
	    d.crc32 != WIRE_CRC(d) || !d.channels[0].subtractor_gain_ppm) {
		return -EBADMSG;
	}
	*desc = d;
	return 0;
}

int cal_service_inspect(const analog_board_ops_t *board, const cal_storage_ops_t *storage,
		     struct bias_eeprom_descriptor_v1 *desc, ctrl_calibration_t *cal, uint32_t *record_crc)
{
	if (!desc || !cal) {
		return -EINVAL;
	}
	struct bias_eeprom_descriptor_v1 d;
	int rc = cal_service_load_descriptor(board, &d);
	if (rc) {
		return rc;
	}
	struct cal_mzm_record_v2 r;
	if (record_crc) {
		*desc = d; /* Preserve validated descriptor even if the record is corrupt. */
	}
	rc = transfer(storage, &r, false);
	if (rc) {
		return rc;
	}
	if (record_crc) {
		*record_crc = r.crc32;
	}
	if (r.magic != RECORD_MAGIC || r.crc32 != WIRE_CRC(r) || r.descriptor_crc != d.crc32 ||
	    !valid_record(&r) || d.channels[0].vpi_uv != (uint32_t)((double)r.vpi_v * 1e6 + 0.5)) {
		return -EBADMSG;
	}
	*desc = d;
	*cal = (ctrl_calibration_t){
		.fit = r.fit, .null_v = r.null_v, .vpi_v = r.vpi_v, .cal_pilot_v = r.cal_pilot_v,
		.h1_ref_phase = r.h1_ref_phase, .h2_ref_phase = r.h2_ref_phase,
		.has_ref_phases = r.has_ref_phases != 0u,
	};
	return 0;
}

int cal_service_load(const analog_board_ops_t *board, const cal_storage_ops_t *storage,
		     struct bias_eeprom_descriptor_v1 *desc, ctrl_calibration_t *cal)
{
	return cal_service_inspect(board, storage, desc, cal, NULL);
}
```

## src/cal_service.h
```c
/* SPDX-License-Identifier: Apache-2.0 */
#pragma once

#include <bias/analog_board.h>
#include <ctrl_observer.h>

/* Optional record transport. Descriptor I/O remains in analog_board_ops_t.
 * write_page receives one aligned page (or a final partial page) and must
 * complete its write cycle before returning. */
typedef struct {
	int (*read)(uint8_t offset, void *data, size_t len);
	int (*write_page)(uint8_t offset, const void *data, size_t len);
} cal_storage_ops_t;

int cal_service_voltage_bounds(const struct bias_eeprom_descriptor_v1 *desc,
			       float *min_v, float *max_v);
int cal_service_voltage_to_dac_code(const struct bias_eeprom_descriptor_v1 *desc,
				    float voltage, uint16_t *code);
int cal_service_load_descriptor(const analog_board_ops_t *board, struct bias_eeprom_descriptor_v1 *desc);
/* NULL storage uses U21. Outputs are published only after validation. */
int cal_service_load(const analog_board_ops_t *board, const cal_storage_ops_t *storage,
		     struct bias_eeprom_descriptor_v1 *desc, ctrl_calibration_t *cal);
int cal_service_save(const analog_board_ops_t *board, const cal_storage_ops_t *storage,
		     struct bias_eeprom_descriptor_v1 *desc, const ctrl_calibration_t *cal);
int cal_service_inspect(const analog_board_ops_t *board, const cal_storage_ops_t *storage,
			struct bias_eeprom_descriptor_v1 *desc, ctrl_calibration_t *cal,
			uint32_t *record_crc);
```

## src/cli_service.c
```c
/* SPDX-License-Identifier: Apache-2.0 */
#include "cli_service.h"
#include "ctrl_thread.h"
#include "experiment_output.h"

#include <analog_board_mzm.h>
#include <bias/analog_board.h>
#include <errno.h>
#include <limits.h>
#include <math.h>
#include <stdarg.h>
#include <stdbool.h>
#include <stdint.h>
#include <stdio.h>
#include <string.h>
#include <zephyr/device.h>
#include <zephyr/version.h>
#include <zephyr/drivers/uart.h>
#include <zephyr/kernel.h>
#include <zephyr/sys/atomic.h>
#include <zephyr/sys/printk.h>

#define CLI_THREAD_PRIO 8
#define CLI_STACK_SIZE 2048
#define CLI_RING_SIZE 128U
#define CLI_LINE_SIZE 96U
#define CLI_MAX_ARGS 6

static K_MUTEX_DEFINE(console_tx);
static atomic_t quiet_console;

static void default_write(const char *text, void *ctx)
{
	ARG_UNUSED(ctx);
	k_mutex_lock(&console_tx, K_FOREVER);
	printk("%s", text);
	k_mutex_unlock(&console_tx);
}

static void cli_printf(cli_write_fn_t out, void *ctx, const char *fmt, ...)
{
	char buf[160];
	va_list ap;

	va_start(ap, fmt);
	int n = vsnprintf(buf, sizeof(buf), fmt, ap);
	va_end(ap);

	if (n < 0) {
		return;
	}
	cli_write_fn_t writer = (out != NULL) ? out : default_write;
	writer(buf, ctx);
}

static int32_t float_to_mv(float v)
{
	if (!isfinite(v)) {
		return 0;
	}
	double scaled = (double)v * 1000.0;

	if (scaled >= (double)INT32_MAX) {
		return INT32_MAX;
	}
	if (scaled <= (double)INT32_MIN) {
		return INT32_MIN;
	}
	return (int32_t)(scaled >= 0.0 ? (scaled + 0.5) : (scaled - 0.5));
}

static void fmt_fixed3(char *buf, size_t sz, float val)
{
	if (!isfinite(val)) {
		(void)snprintf(buf, sz, "nan");
		return;
	}
	double scaled = (double)val * 1000.0;

	if (scaled > (double)INT32_MAX) {
		(void)snprintf(buf, sz, "ovf");
		return;
	}
	if (scaled < (double)(INT32_MIN + 1)) {
		(void)snprintf(buf, sz, "-ovf");
		return;
	}
	int32_t iv = (int32_t)(scaled >= 0.0 ? (scaled + 0.5) : (scaled - 0.5));
	bool neg = iv < 0;
	uint32_t mag = neg ? (uint32_t)(-iv) : (uint32_t)iv;

	(void)snprintf(buf, sz, "%s%u.%03u", neg ? "-" : "",
		       (unsigned int)(mag / 1000U), (unsigned int)(mag % 1000U));
}

static int parse_decimal(const char *s, float *out)
{
	if (s == NULL || *s == '\0' || out == NULL) {
		return -EINVAL;
	}
	bool neg = false;

	if (*s == '-') {
		neg = true;
		s++;
	} else if (*s == '+') {
		s++;
	}

	bool has_digit = false;
	bool seen_dot = false;
	double int_part = 0.0;
	double frac_part = 0.0;
	double frac_scale = 0.1;

	for (; *s != '\0'; s++) {
		unsigned char c = (unsigned char)*s;

		if (c >= '0' && c <= '9') {
			has_digit = true;
			double d = (double)(c - '0');

			if (!seen_dot) {
				int_part = int_part * 10.0 + d;
				if (int_part > 1e6) {
					return -ERANGE;
				}
			} else {
				frac_part += d * frac_scale;
				frac_scale *= 0.1;
			}
		} else if (c == '.' && !seen_dot) {
			seen_dot = true;
		} else {
			return -EINVAL;
		}
	}
	if (!has_digit) {
		return -EINVAL;
	}

	double val = int_part + frac_part;

	if (neg) {
		val = -val;
	}
	float f = (float)val;

	if (!isfinite(f)) {
		return -EINVAL;
	}
	*out = f;
	return 0;
}

static int parse_count(const char *str, unsigned *count)
{
	if (str == NULL || *str == '\0' || count == NULL) {
		return -EINVAL;
	}
	unsigned n = 0;

	for (; *str; ++str) {
		if (*str < '0' || *str > '9') {
			return -EINVAL;
		}
		n = n * 10 + (*str - '0');
		if (n > 1000000) {
			return -ERANGE;
		}
	}
	*count = n;
	return 0;
}

static const char *state_name(ctrl_state_t st)
{
	switch (st) {
	case CTRL_STATE_IDLE:
		return "IDLE";
	case CTRL_STATE_SCAN:
		return "SCAN";
	case CTRL_STATE_CAL:
		return "CAL";
	case CTRL_STATE_RUNNING:
		return "RUNNING";
	case CTRL_STATE_EXP_HOLD:
		return "EXP_HOLD";
	case CTRL_STATE_FAULT:
		return "FAULT";
	default:
		return "UNKNOWN";
	}
}

static const char *target_name(bias_point_t tgt)
{
	switch (tgt) {
	case BIAS_POINT_QUAD:
		return "QUAD";
	case BIAS_POINT_MAX:
		return "MAX";
	case BIAS_POINT_MIN:
		return "MIN";
	case BIAS_POINT_CUSTOM:
		return "CUSTOM";
	default:
		return "UNKNOWN";
	}
}

static void cmd_help(cli_write_fn_t out, void *ctx)
{
	cli_printf(out, ctx,
		   "Commands:\n"
		   "  help\n"
		   "  status\n"
		   "  cal bias\n"
		   "  scan vpi\n"
		   "  start\n"
		   "  stop\n"
		   "  target quad|min|max|custom <deg>\n");
	cli_printf(out, ctx,
		   "  ctrl cfg [<param> <val>]\n"
		   "  save\n"
		   "  load\n"
		   "  reinit\n"
		   "  eeprom init\n");
	cli_printf(out, ctx, "  hw info\n  adc stat|dump <n>\n"
		   "  meas <bias_mv> <pilot_mv> <wait_blocks> <n_blocks>\n"
		   "  step <v0_mv> <v1_mv> <pilot_mv> <n_blocks>\n  telemetry on|off\n");
}

static int cmd_status(cli_write_fn_t out, void *ctx)
{
	ctrl_thread_status_t st;
	int st_rc = ctrl_thread_get_status(&st);
	uint32_t drops = rt_pipeline_drop_count();
	uint32_t crc_errs = rt_pipeline_crc_error_count();
	int rt_flt = rt_pipeline_fault();
	char deg_buf[16];
	char h1m[16], h1p[16], h2m[16], h2p[16], dcm[16];

	fmt_fixed3(deg_buf, sizeof(deg_buf), st.custom_deg);
	fmt_fixed3(h1m, sizeof(h1m), st.harmonics.h1_magnitude * 1000.0f);
	fmt_fixed3(h1p, sizeof(h1p), st.harmonics.h1_phase);
	fmt_fixed3(h2m, sizeof(h2m), st.harmonics.h2_magnitude * 1000.0f);
	fmt_fixed3(h2p, sizeof(h2p), st.harmonics.h2_phase);
	fmt_fixed3(dcm, sizeof(dcm), st.harmonics.dc_power * 1000.0f);

	cli_printf(out, ctx,
		   "state=%s init=%d target=%s(%s deg) cal=%d locked=%d hold_assist=%d frozen=%d recal=%u\n",
		   state_name(st.state), st_rc == 0 ? 1 : 0, target_name(st.target), deg_buf,
		   st.calibrated ? 1 : 0, st.locked ? 1 : 0, st.hold_assist_active ? 1 : 0,
		   st.frozen ? 1 : 0, (unsigned int)st.recal_count);
	cli_printf(out, ctx,
		   "bias=%d mV scan_vpi=%d mV vpi=%d mV null=%d mV updates=%u pass=%u step=%u\n",
		   (int)float_to_mv(st.bias_v), (int)float_to_mv(st.scan_vpi_v),
		   (int)float_to_mv(st.vpi_v), (int)float_to_mv(st.null_v),
		   (unsigned int)st.updates, st.scan_pass, (unsigned int)st.scan_step);
	cli_printf(out, ctx,
		   "harmonics h1=%s mV@%s rad h2=%s mV@%s rad dc=%s mV\n",
		   h1m, h1p, h2m, h2p, dcm);
	cli_printf(out, ctx,
		   "drops=%u crc_errs=%u fault=%d cleanup_err=%d load_err=%d rt_fault=%d\n",
		   (unsigned int)drops, (unsigned int)crc_errs,
		   st.fault, st.cleanup_error, st.load_error, rt_flt);
	return 0;
}

static int cmd_ctrl_cfg(int argc, char **argv, cli_write_fn_t out, void *ctx)
{
	ctrl_thread_cfg_t cfg;
	int rc = ctrl_thread_get_cfg(&cfg);

	if (rc && rc != -ENODEV) {
		cli_printf(out, ctx, "ctrl cfg: err=%d\n", rc);
		return rc;
	}
	if (argc == 2) {
		char pilot[16], gain[16], kp[16], ki[16], rho[16];

		fmt_fixed3(pilot, sizeof(pilot), cfg.pilot_v * 1000.0f);
		fmt_fixed3(gain, sizeof(gain), cfg.gain);
		fmt_fixed3(kp, sizeof(kp), cfg.kp);
		fmt_fixed3(ki, sizeof(ki), cfg.ki);
		fmt_fixed3(rho, sizeof(rho), cfg.rho_thresh);
		cli_printf(out, ctx,
			   "pilot=%s mV wait=%u avg=%u mode=%s G=%s kp=%s ki=%s recal=%u rho_thresh=%s hold_ticks=%u\n",
			   pilot, (unsigned int)cfg.wait_blocks, (unsigned int)cfg.avg_blocks,
			   cfg.use_gain ? "gain" : "pi", gain, kp, ki,
			   cfg.recal_auto ? 1U : 0U, rho, (unsigned int)cfg.hold_ticks);
		return 0;
	}
	if (argc != 4) {
		cli_printf(out, ctx,
			   "Usage: ctrl cfg [<pilot|wait|avg|gain|kp|ki|recal|rho_thresh|hold_ticks> <val>]\n");
		return -EINVAL;
	}

	const char *key = argv[2];
	const char *val_str = argv[3];
	float fval = 0.0f;
	unsigned uval = 0U;

	if (strcmp(key, "pilot") == 0) {
		rc = parse_decimal(val_str, &fval);
		if (!rc) {
			cfg.pilot_v = fval / 1000.0f;
		}
	} else if (strcmp(key, "wait") == 0) {
		rc = parse_count(val_str, &uval);
		if (!rc) {
			if (uval > 25U) {
				rc = -ERANGE;
			} else {
				cfg.wait_blocks = (uint8_t)uval;
			}
		}
	} else if (strcmp(key, "avg") == 0) {
		rc = parse_count(val_str, &uval);
		if (!rc) {
			if (uval < 1U || uval > 16U) {
				rc = -ERANGE;
			} else {
				cfg.avg_blocks = (uint8_t)uval;
			}
		}
	} else if (strcmp(key, "gain") == 0) {
		rc = parse_decimal(val_str, &fval);
		if (!rc) {
			cfg.use_gain = true;
			cfg.gain = fval;
			cfg.kp = 0.0f;
		}
	} else if (strcmp(key, "kp") == 0) {
		rc = parse_decimal(val_str, &fval);
		if (!rc) {
			if (cfg.use_gain && cfg.ki <= 0.0f) {
				cfg.ki = 0.85f;
			}
			cfg.use_gain = false;
			cfg.kp = fval;
		}
	} else if (strcmp(key, "ki") == 0) {
		rc = parse_decimal(val_str, &fval);
		if (!rc) {
			cfg.use_gain = false;
			cfg.ki = fval;
		}
	} else if (strcmp(key, "recal") == 0) {
		rc = parse_count(val_str, &uval);
		if (!rc) {
			if (uval > 1U) {
				rc = -ERANGE;
			} else {
				cfg.recal_auto = (uval != 0U);
			}
		}
	} else if (strcmp(key, "rho_thresh") == 0) {
		rc = parse_decimal(val_str, &fval);
		if (!rc) {
			cfg.rho_thresh = fval;
		}
	} else if (strcmp(key, "hold_ticks") == 0) {
		rc = parse_count(val_str, &uval);
		if (!rc) {
			if (uval < 1U || uval > 1000U) {
				rc = -ERANGE;
			} else {
				cfg.hold_ticks = (uint16_t)uval;
			}
		}
	} else {
		cli_printf(out, ctx, "ctrl cfg: unknown param '%s'\n", key);
		return -EINVAL;
	}

	if (!rc) {
		rc = ctrl_thread_set_cfg(&cfg);
	}
	cli_printf(out, ctx, rc == 0 ? "ctrl cfg: ok\n" : "ctrl cfg: err=%d\n", rc);
	return rc;
}

static int cmd_target(int argc, char **argv, cli_write_fn_t out, void *ctx)
{
	int rc;

	if (argc == 2 && strcmp(argv[1], "quad") == 0) {
		rc = ctrl_thread_set_target(BIAS_POINT_QUAD, 90.0f);
	} else if (argc == 2 && strcmp(argv[1], "min") == 0) {
		rc = ctrl_thread_set_target(BIAS_POINT_MIN, 0.0f);
	} else if (argc == 2 && strcmp(argv[1], "max") == 0) {
		rc = ctrl_thread_set_target(BIAS_POINT_MAX, 180.0f);
	} else if (argc == 3 && strcmp(argv[1], "custom") == 0) {
		float deg = 0.0f;

		rc = parse_decimal(argv[2], &deg);
		if (rc < 0) {
			cli_printf(out, ctx, "target custom: invalid degree '%s' (err=%d)\n",
				   argv[2], rc);
			return rc;
		}
		rc = ctrl_thread_set_target(BIAS_POINT_CUSTOM, deg);
	} else {
		cli_printf(out, ctx, "Usage: target quad|min|max|custom <deg>\n");
		return -EINVAL;
	}

	if (rc == 0) {
		cli_printf(out, ctx, "target: ok\n");
	} else {
		cli_printf(out, ctx, "target: err=%d\n", rc);
	}
	return rc;
}

static int cmd_eeprom_init(cli_write_fn_t out, void *ctx)
{
	ctrl_thread_status_t st;

	if (ctrl_thread_get_status(&st) == 0 &&
	    (st.state == CTRL_STATE_SCAN || st.state == CTRL_STATE_CAL ||
	     st.state == CTRL_STATE_RUNNING || st.state == CTRL_STATE_EXP_HOLD)) {
		cli_printf(out, ctx, "eeprom init: busy (err=%d)\n", -EBUSY);
		return -EBUSY;
	}

	const analog_board_ops_t *ops = analog_board_get_ops();

	if (ops == NULL || ops->store_calibration == NULL) {
		cli_printf(out, ctx, "eeprom init: err=%d\n", -ENODEV);
		return -ENODEV;
	}

	struct bias_eeprom_descriptor_v1 desc;

	mzm_20261110_fill_default_descriptor(&desc);
	int rc = ops->store_calibration(&desc);

	if (rc == 0 && ops->load_calibration != NULL) {
		rc = ops->load_calibration(&desc);
	}
	if (rc == 0) {
		cli_printf(out, ctx, "eeprom init: ok crc=0x%08X\n",
			   (unsigned int)desc.crc32);
	} else {
		cli_printf(out, ctx, "eeprom init: err=%d\n", rc);
	}
	return rc;
}

/* The wire limit includes the CR inserted by the UART console before LF. */
static int send_row(char *row, int length, cli_write_fn_t out, void *ctx)
{
	if (length < 0 || length + 1 > 135) {
		return -EOVERFLOW;
	}
	(out ? out : default_write)(row, ctx);
	return 0;
}

int cli_measure_row(const rt_pipeline_block_t *b, bool step, float bias, uint16_t code,
		    cli_write_fn_t out, void *ctx)
{
	char row[135], values[7][16];
	const float volts[] = {bias, b->pilot_amplitude_v, b->harmonics.dc_power,
			       b->min_v[0], b->max_v[0], b->min_v[1], b->max_v[1]};
	for (unsigned i = 0; i < 3; ++i) {
		fmt_fixed3(values[i], sizeof(values[i]), volts[i] * 1000.f);
	}
	/* Extrema use 0.1 mV. This leaves room for both 32-bit clocks and
	 * full-scale signed I/Q even on the longest sample row. */
	for (unsigned i = 3; i < ARRAY_SIZE(volts); ++i) {
		int tenths = float_to_mv(volts[i] * 10.f);
		unsigned magnitude = tenths < 0 ? -tenths : tenths;
		snprintf(values[i], sizeof(values[i]), "%s%u.%u", tenths < 0 ? "-" : "",
			 magnitude / 10, magnitude % 10);
	}
	int n = snprintf(row, sizeof(row),
			 "%s,%u,%u,%s,%u,%s,%d,%d,%d,%d,%s,%s,%s,%s,%s,%u,%u\n",
			 step ? "STEP" : "MEAS", b->seq, b->t_ms, values[0], code, values[1],
			 float_to_mv(b->iq[0] * 1000.f), float_to_mv(b->iq[1] * 1000.f),
			 float_to_mv(b->iq[2] * 1000.f), float_to_mv(b->iq[3] * 1000.f),
			 values[2], values[3], values[4], values[5], values[6],
			 rt_pipeline_drop_count(), rt_pipeline_crc_error_count());
	return send_row(row, n, out, ctx);
}

int cli_tel_row(const ctrl_thread_status_t *st, const rt_pipeline_block_t *b,
		float phase, float error, float radius, const float iq[4])
{
	char row[135], bias[16], phi[16], err[16], r[16], dc[16];
	fmt_fixed3(bias, sizeof(bias), st->bias_v * 1000.f);
	fmt_fixed3(phi, sizeof(phi), phase);
	fmt_fixed3(err, sizeof(err), error);
	fmt_fixed3(r, sizeof(r), radius);
	fmt_fixed3(dc, sizeof(dc), st->harmonics.dc_power * 1000.f);
	int n = snprintf(row, sizeof(row), "TEL,%u,%u,%s,%s,%s,%s,%d,%d,%d,%d,%s,%d,%d,%u,%u,%u\n",
			 st->updates, b->t_ms, bias, phi, err, r,
			 float_to_mv(iq[0] * 1000.f), float_to_mv(iq[1] * 1000.f),
			 float_to_mv(iq[2] * 1000.f), float_to_mv(iq[3] * 1000.f),
			 dc, st->locked ? 1 : 0, st->frozen ? 1 : 0,
			 (unsigned int)st->recal_count,
			 rt_pipeline_drop_count(), rt_pipeline_crc_error_count());
	return send_row(row, n, NULL, NULL);
}

void cli_hw_result(const uint16_t regs[4], uint32_t desc_crc, uint32_t record_crc,
		   int cal_rc, cli_write_fn_t out, void *ctx)
{
	cli_printf(out, ctx, "SYSCLK=%u ADS131M02 ID=0x%04X STAT=0x%04X MODE=0x%04X CLOCK=0x%04X\n",
		   sys_clock_hw_cycles_per_sec(), regs[0], regs[1], regs[2], regs[3]);
	cli_printf(out, ctx, "U21 desc_crc=0x%08X cal_status=%d cal_crc=0x%08X\n",
		   desc_crc, cal_rc, record_crc);
	cli_printf(out, ctx, "fw=P7 rev=%s board=%s zephyr=%s build=%s\n",
		   BIAS_FW_REV, CONFIG_BOARD, KERNEL_VERSION_STRING,
		   STRINGIFY(BUILD_VERSION));
}

void cli_adc_result(bool dump, unsigned segment, unsigned count, const rt_adc_stats_t *stats,
		    cli_write_fn_t out, void *ctx)
{
	if (!dump) {
		uint64_t mhz = ((uint64_t)sys_clock_hw_cycles_per_sec() * count * 1000 +
				stats->total / 2) / stats->total;
		cli_printf(out, ctx, "ADC_STAT,n=%u,total_cyc=%llu,fs_hz=%u.%03u,dt_min_cyc=%u,dt_max_cyc=%u,drops=%u,crc=%u\n",
			   count, (unsigned long long)stats->total, (unsigned)(mhz / 1000),
			   (unsigned)(mhz % 1000), stats->min, stats->max,
			   rt_pipeline_drop_count(), rt_pipeline_crc_error_count());
		return;
	}
	cli_printf(out, ctx, "DUMP_SEG,%u,%u,%u\n", segment, count, stats->first);
	for (unsigned i = 0; i < count;) {
		char row[160] = "DUMP_DATA";
		size_t used = strlen(row);
		for (unsigned j = 0; j < 16 && i < count; ++j, ++i) {
			used += snprintf(row + used, sizeof(row) - used, ",%d",
					 rt_pipeline_dump_sample(i));
		}
		strcpy(row + used, "\n");
		(out ? out : default_write)(row, ctx);
	}
}

static int experiment(int argc, char **argv, cli_write_fn_t out, void *ctx)
{
	unsigned count, wait = 0;
	if (!strcmp(argv[0], "hw") && argc == 2 && !strcmp(argv[1], "info")) {
		return ctrl_thread_hw_info(out, ctx);
	}
	if (!strcmp(argv[0], "adc") && argc == 3 &&
	    (!strcmp(argv[1], "dump") || !strcmp(argv[1], "stat"))) {
		int rc = parse_count(argv[2], &count);
		return rc ? rc : ctrl_thread_adc(!strcmp(argv[1], "dump"), count, out, ctx);
	}
	if (!strcmp(argv[0], "telemetry") && argc == 2 &&
	    (!strcmp(argv[1], "on") || !strcmp(argv[1], "off"))) {
		bool enable = !strcmp(argv[1], "on");
		ctrl_thread_telemetry(enable);
		atomic_set(&quiet_console, enable);
		return 0;
	}
	bool step = !strcmp(argv[0], "step");
	if (argc != 5 || (!step && strcmp(argv[0], "meas"))) {
		return -EINVAL;
	}
	float initial, final, pilot;
	int rc = parse_decimal(argv[1], &initial);
	if (rc) {
		return rc;
	}
	final = initial;
	rc = step ? parse_decimal(argv[2], &final) : parse_count(argv[3], &wait);
	if (!rc) {
		rc = parse_decimal(argv[step ? 3 : 2], &pilot);
	}
	if (!rc) {
		rc = parse_count(argv[4], &count);
	}
	return rc ? rc : ctrl_thread_measure(step, initial / 1000.f, final / 1000.f,
					     pilot / 1000.f, wait, count, out, ctx);
}

int cli_service_exec_line(const char *line, cli_write_fn_t out, void *ctx)
{
	if (line == NULL) {
		return -EINVAL;
	}

	size_t len = strlen(line);

	if (len >= CLI_LINE_SIZE) {
		cli_printf(out, ctx, "line too long (err=%d)\n", -E2BIG);
		return -E2BIG;
	}

	char buf[CLI_LINE_SIZE];

	memcpy(buf, line, len + 1U);

	char *argv[CLI_MAX_ARGS];
	int argc = 0;
	char *save = NULL;
	char *tok = strtok_r(buf, " \t\r\n", &save);

	while (tok != NULL) {
		if (argc >= CLI_MAX_ARGS) {
			cli_printf(out, ctx, "too many arguments (err=%d)\n", -E2BIG);
			return -E2BIG;
		}
		argv[argc++] = tok;
		tok = strtok_r(NULL, " \t\r\n", &save);
	}
	if (argc == 0) {
		return 0;
	}

	if (!strcmp(argv[0], "hw") || !strcmp(argv[0], "adc") || !strcmp(argv[0], "meas") ||
	    !strcmp(argv[0], "step") || !strcmp(argv[0], "telemetry")) {
		int rc = experiment(argc, argv, out, ctx);
		cli_printf(out, ctx, rc ? "%s: err=%d\n" : "%s: ok\n", argv[0], rc);
		return rc;
	}
	if (argc == 1 && strcmp(argv[0], "help") == 0) {
		cmd_help(out, ctx);
		return 0;
	}
	if (argc == 1 && strcmp(argv[0], "status") == 0) {
		return cmd_status(out, ctx);
	}
	if (argc == 2 && strcmp(argv[0], "cal") == 0 && strcmp(argv[1], "bias") == 0) {
		int rc = ctrl_thread_start_cal(true);

		cli_printf(out, ctx, rc == 0 ? "cal bias: ok\n" : "cal bias: err=%d\n", rc);
		return rc;
	}
	if (argc == 2 && strcmp(argv[0], "scan") == 0 && strcmp(argv[1], "vpi") == 0) {
		int rc = ctrl_thread_start_cal(false);

		cli_printf(out, ctx, rc == 0 ? "scan vpi: ok\n" : "scan vpi: err=%d\n", rc);
		return rc;
	}
	if (argc == 1 && strcmp(argv[0], "start") == 0) {
		int rc = ctrl_thread_start();

		cli_printf(out, ctx, rc == 0 ? "start: ok\n" : "start: err=%d\n", rc);
		return rc;
	}
	if (argc == 1 && strcmp(argv[0], "stop") == 0) {
		int rc = ctrl_thread_stop();

		cli_printf(out, ctx, rc == 0 ? "stop: ok\n" : "stop: err=%d\n", rc);
		return rc;
	}
	if (strcmp(argv[0], "target") == 0) {
		return cmd_target(argc, argv, out, ctx);
	}
	if (argc >= 2 && strcmp(argv[0], "ctrl") == 0 && strcmp(argv[1], "cfg") == 0) {
		return cmd_ctrl_cfg(argc, argv, out, ctx);
	}
	if (argc == 1 && strcmp(argv[0], "save") == 0) {
		int rc = ctrl_thread_save_cal();

		cli_printf(out, ctx, rc == 0 ? "save: ok\n" : "save: err=%d\n", rc);
		return rc;
	}
	if (argc == 1 && strcmp(argv[0], "load") == 0) {
		int rc = ctrl_thread_load_cal();

		cli_printf(out, ctx, rc == 0 ? "load: ok\n" : "load: err=%d\n", rc);
		return rc;
	}
	if (argc == 1 && strcmp(argv[0], "reinit") == 0) {
		int rc = ctrl_thread_init(NULL, NULL, false);

		if (rc == 0) {
			cli_printf(out, ctx, "reinit: ok\n");
		} else if (rc == -EBADMSG) {
			cli_printf(out, ctx, "reinit: uncalibrated (err=%d), run cal bias\n", rc);
		} else {
			cli_printf(out, ctx, "reinit: err=%d\n", rc);
		}
		return rc;
	}
	if (argc == 2 && strcmp(argv[0], "eeprom") == 0 && strcmp(argv[1], "init") == 0) {
		return cmd_eeprom_init(out, ctx);
	}

	cli_printf(out, ctx, "Unknown command: %s (type 'help')\n", argv[0]);
	return -EINVAL;
}

#if defined(CONFIG_UART_INTERRUPT_DRIVEN) && DT_HAS_CHOSEN(zephyr_console)

static const struct device *const console_uart = DEVICE_DT_GET(DT_CHOSEN(zephyr_console));

static K_THREAD_STACK_DEFINE(cli_stack, CLI_STACK_SIZE);
static struct k_thread cli_thread;
static K_SEM_DEFINE(rx_sem, 0, 1);

static uint8_t rx_ring[CLI_RING_SIZE];
static volatile uint16_t rx_head;
static volatile uint16_t rx_tail;
static atomic_t rx_overflow;
static atomic_t cli_started;

static void uart_rx_isr(const struct device *dev, void *user_data)
{
	ARG_UNUSED(user_data);
	bool notify = false;

	uart_irq_update(dev);
	while (uart_irq_rx_ready(dev) > 0) {
		uint8_t byte;
		int n = uart_fifo_read(dev, &byte, 1);

		if (n <= 0) {
			break;
		}
		uint16_t next = (uint16_t)((rx_head + 1U) % CLI_RING_SIZE);

		if (next == rx_tail) {
			atomic_set(&rx_overflow, 1);
		} else {
			rx_ring[rx_head] = byte;
			rx_head = next;
		}
		notify = true;
	}
	if (notify) {
		k_sem_give(&rx_sem);
	}
}

static bool pop_rx_byte(uint8_t *out)
{
	unsigned int key = irq_lock();
	bool has_data = (rx_head != rx_tail);

	if (has_data) {
		*out = rx_ring[rx_tail];
		rx_tail = (uint16_t)((rx_tail + 1U) % CLI_RING_SIZE);
	}
	irq_unlock(key);
	return has_data;
}

static void cli_thread_entry(void *a, void *b, void *c)
{
	ARG_UNUSED(a);
	ARG_UNUSED(b);
	ARG_UNUSED(c);

	char line_buf[CLI_LINE_SIZE];
	size_t line_len = 0;
	bool line_overflow = false;
	bool prev_cr = false;

	printk("Phase 7 CLI ready. Type 'help'.\n> ");

	for (;;) {
		k_sem_take(&rx_sem, K_FOREVER);

		if (atomic_cas(&rx_overflow, 1, 0)) {
			line_len = 0;
			line_overflow = false;
			printk("\nUART RX overflow\n> ");
		}

		uint8_t byte;

		while (pop_rx_byte(&byte)) {
			if (byte == '\n' && prev_cr) {
				prev_cr = false;
				continue;
			}
			prev_cr = (byte == '\r');

			if (byte == '\r' || byte == '\n') {
				if (!atomic_get(&quiet_console)) {
					printk("\n");
				}
				if (line_overflow) {
					printk("Line too long (err=%d)\n", -E2BIG);
				} else {
					line_buf[line_len] = '\0';
					if (line_len > 0U) {
						(void)cli_service_exec_line(line_buf, NULL, NULL);
					}
				}
				line_len = 0;
				line_overflow = false;
				if (!atomic_get(&quiet_console)) {
					printk("> ");
				}
			} else if (byte == '\b' || byte == 0x7fU) {
				if (line_overflow) {
					line_overflow = false;
					line_len = 0;
					printk("\n> ");
				} else if (line_len > 0U) {
					line_len--;
					if (!atomic_get(&quiet_console)) {
						printk("\b \b");
					}
				}
			} else if (byte >= 0x20U && byte < 0x7fU) {
				if (line_len + 1U < CLI_LINE_SIZE) {
					line_buf[line_len++] = (char)byte;
					if (!atomic_get(&quiet_console)) {
						printk("%c", byte);
					}
				} else {
					line_overflow = true;
				}
			}
		}
	}
}

int cli_service_start(void)
{
	if (!atomic_cas(&cli_started, 0, 1)) {
		return -EALREADY;
	}
	if (!device_is_ready(console_uart)) {
		atomic_clear(&cli_started);
		return -ENODEV;
	}

	uart_irq_rx_disable(console_uart);
	rx_head = 0;
	rx_tail = 0;
	atomic_clear(&rx_overflow);
	k_sem_reset(&rx_sem);

	int rc = uart_irq_callback_user_data_set(console_uart, uart_rx_isr, NULL);

	if (rc < 0) {
		atomic_clear(&cli_started);
		return rc;
	}

	k_thread_create(&cli_thread, cli_stack, K_THREAD_STACK_SIZEOF(cli_stack),
			cli_thread_entry, NULL, NULL, NULL,
			CLI_THREAD_PRIO, 0, K_NO_WAIT);
	uart_irq_rx_enable(console_uart);
	return 0;
}

#else

int cli_service_start(void)
{
	return -ENOTSUP;
}

#endif /* CONFIG_UART_INTERRUPT_DRIVEN && DT_HAS_CHOSEN(zephyr_console) */
```

## src/cli_service.h
```c
/* SPDX-License-Identifier: Apache-2.0 */
#ifndef BIAS_CLI_SERVICE_H
#define BIAS_CLI_SERVICE_H

typedef void (*cli_write_fn_t)(const char *text, void *ctx);

int cli_service_start(void);
int cli_service_exec_line(const char *line, cli_write_fn_t out, void *ctx);

#endif /* BIAS_CLI_SERVICE_H */
```

## src/ctrl_thread.h
```c
/* SPDX-License-Identifier: Apache-2.0 */
#pragma once

#include "cal_service.h"
#include "rt_pipeline.h"
#include "cli_service.h"
#include <ctrl_modulator.h>

typedef enum {
	CTRL_STATE_IDLE, CTRL_STATE_SCAN, CTRL_STATE_CAL, CTRL_STATE_RUNNING, CTRL_STATE_FAULT,
	CTRL_STATE_EXP_HOLD
} ctrl_state_t;

typedef struct {
	ctrl_state_t state;
	bias_point_t target;
	float custom_deg, bias_v, scan_vpi_v, vpi_v, null_v;
	bool calibrated, locked, hold_assist_active;
	bool frozen;
	uint32_t updates, scan_step, recal_count;
	unsigned scan_pass;
	harmonic_data_t harmonics;
	int fault, cleanup_error, load_error;
} ctrl_thread_status_t;

typedef struct {
	float pilot_v;
	float gain;
	float kp;
	float ki;
	float rho_thresh;
	uint16_t hold_ticks;
	uint8_t wait_blocks;
	uint8_t avg_blocks;
	bool use_gain;
	bool recal_auto;
} ctrl_thread_cfg_t;

/* Thread context. Initialize the board first. NULL ops select production.
 * A missing/invalid affine record returns its load error but permits a new
 * scan if the board descriptor is valid. Reinitialize to clear a fault.
 * In manual mode feed rt_pipeline_ingest continuously from a separate
 * producer (including during synchronized DC writes). */
int ctrl_thread_init(const analog_board_ops_t *board, const cal_storage_ops_t *storage, bool manual);
int ctrl_thread_start(void);
int ctrl_thread_stop(void);
int ctrl_thread_set_target(bias_point_t point, float custom_deg);
int ctrl_thread_start_cal(bool two_pass);
int ctrl_thread_save_cal(void);
int ctrl_thread_load_cal(void);
int ctrl_thread_get_status(ctrl_thread_status_t *out);
int ctrl_thread_get_cfg(ctrl_thread_cfg_t *out);
int ctrl_thread_set_cfg(const ctrl_thread_cfg_t *cfg);

int ctrl_thread_measure(bool step, float initial, float final, float pilot, unsigned wait,
			unsigned count, cli_write_fn_t out, void *ctx);
int ctrl_thread_adc(bool dump, unsigned count, cli_write_fn_t out, void *ctx);
int ctrl_thread_hw_info(cli_write_fn_t out, void *ctx);
void ctrl_thread_telemetry(bool enable);
```

## src/diag_cli.h
```c
/* SPDX-License-Identifier: Apache-2.0 */
#pragma once

struct diag_boot_status {
	int board_rc;
	int oled_rc;
	int keys_rc;
	int eeprom_rc;
	int adc_rc;
};

int diag_cli_init(const struct diag_boot_status *boot);
void diag_cli_poll(void);
```

## src/experiment_output.h
```c
/* SPDX-License-Identifier: Apache-2.0 */
#pragma once

#include "ctrl_thread.h"

/* Thread-context wire formatting. */
int cli_measure_row(const rt_pipeline_block_t *b, bool step, float bias, uint16_t code,
		    cli_write_fn_t out, void *ctx);
int cli_tel_row(const ctrl_thread_status_t *st, const rt_pipeline_block_t *b,
		float phase, float error, float radius, const float iq[4]);
void cli_adc_result(bool dump, unsigned segment, unsigned count, const rt_adc_stats_t *stats,
		    cli_write_fn_t out, void *ctx);
void cli_hw_result(const uint16_t regs[4], uint32_t desc_crc, uint32_t record_crc,
		   int cal_rc, cli_write_fn_t out, void *ctx);
```

## src/rt_pipeline.h
```c
/* SPDX-License-Identifier: Apache-2.0 */
#ifndef BIAS_RT_PIPELINE_H
#define BIAS_RT_PIPELINE_H

#include <bias/analog_board.h>
#include <dsp_types.h>
#include <zephyr/kernel.h>

/* Signed 24-bit ADC at gain 1. Pilot amplitude is peak volts at the MZM VA
 * electrode: DAC8568 outputs 0..5.0 V with zero dither at 2.5 V (code 32768),
 * attenuated by -R23/R22 = -12k/120k = -0.1 V/V -> +/-0.25 V peak max.
 */
#define RT_PIPELINE_ADC_V_PER_COUNT (1.2f / 8388608.0f)
#define RT_PIPELINE_PILOT_MAX_V 0.25f

typedef struct {
	harmonic_data_t harmonics;
	uint32_t seq; /* Starts at zero on each start. */
	uint32_t timestamp_cycles; /* Arrival of the final sample in the block. */
	uint32_t t_ms;
	float iq[4]; /* H1 I,Q then H2 I,Q, peak volts. */
	float min_v[2], max_v[2];
	float pilot_amplitude_v;
} rt_pipeline_block_t;

/* Runs in system workqueue context after cutoff. cleanup_error is the first
 * additional failure encountered while isolating the outputs or stopping ADC.
 */
typedef void (*rt_pipeline_fault_cb_t)(int error, int cleanup_error);

/* Thread context. Caller initializes the board and owns route selection.
 * NULL ops selects the production board. Reinitialize after fault cleanup.
 */
int rt_pipeline_init(const analog_board_ops_t *ops, rt_pipeline_fault_cb_t callback);
int rt_pipeline_start(void);
int rt_pipeline_stop(void);
int rt_pipeline_set_dc_code(uint8_t dc, uint16_t code);
int rt_pipeline_set_pilot_amplitude(float amp_v);
int rt_pipeline_get_block(rt_pipeline_block_t *block, k_timeout_t timeout);

/* Schedule VA/pilot at the next block end, optionally a second VA 15 blocks later.
 * first_seq identifies the first complete block after the final write. */
int rt_pipeline_schedule(uint16_t code, float amplitude, bool step, uint16_t final_code,
                         uint32_t *first_seq);
int rt_pipeline_read_regs(uint16_t regs[4]);
typedef struct {
	uint64_t total;
	uint32_t min, max, first;
} rt_adc_stats_t;
int rt_pipeline_capture(bool dump, uint32_t count, bool manual, rt_adc_stats_t *stats);
int32_t rt_pipeline_dump_sample(unsigned index);

int rt_pipeline_fault(void);
bool rt_pipeline_dc_pending(void);
uint32_t rt_pipeline_drop_count(void);
uint32_t rt_pipeline_crc_error_count(void);

/* Start without an ADC for tests. Supply mock board ops to init and feed
 * samples from a single producer. A negative error injects an ADC fault.
 * Quiesce the producer before stop/reinitialization.
 */
int rt_pipeline_start_manual(void);
int rt_pipeline_ingest(int32_t ch0, int32_t ch1, int error, uint32_t timestamp_cycles);

#endif
```
